// (c) IMT - Information Management Technology AG, CH-9470 Buchs, www.imt.ch.
// SW guideline: Technote Coding Guidelines Version. 1.6
//
// Generated by DffGenerator (Version 1.00.0)
// Generated from PingAP.dff

// This file was initially generated but can be manually modified.

#include "PingAPHandler.h"
#include <Imt.Base.HAL.STM32F103MD/SystemPeripherals_USART.h>
//#include <LowLevelIOInterface.h>
// Constructor.
PingAPHandler::PingAPHandler(PingAPIfc& sender) :
    m_sender(sender)
{
    // Nothing to do.
}

// Destructor.
PingAPHandler::~PingAPHandler(void) {
    // Nothing to do.
} //lint !e1762 may change state of handler, must not be const

// See ActivePartAbs.
void PingAPHandler::onInitialize(void) {
    // Nothing to do.
} //lint !e1762 may change state of handler, must not be const

void PingAPHandler::startBenchmark(void) {
	m_startTickCount = RuntimeTimer::getTickCountMs();
	TokenEventProtocol messageOut;
	messageOut.setTokenCounter(0U);
	m_sender.sendTokenEventToToken(messageOut);
}

// See ActivePartAbs.
void PingAPHandler::onStart(void) {
    // Nothing to do.
   startBenchmark();
} //lint !e1762 may change state of handler, must not be const

// Generated TokenEvent protocol handler.
void PingAPHandler::handleTokenEvent(const TokenEventProtocol& message) {
    // TODO implement this Method
   const uint32_t TokenCount = message.getTokenCounter(); 
   if(TokenCount < MESSAGE_LIMIT) {
      TokenEventProtocol messageOut; 
      messageOut.setTokenCounter(TokenCount + 1U); 
      m_sender.sendTokenEventToToken(messageOut);
   }
   else	{
      const uint32_t durationMs = RuntimeTimer::getTickCountMs() - m_startTickCount;
      const uint32_t messagesPerSecond = (1000U * TokenCount) / durationMs;
        
      printf("Messages %u\n", messagesPerSecond);
   //   printf("Time in Milliseconds = %u\n\n", durationMs);
      uint32_t tempData = messagesPerSecond; 
      uint16_t data[4];
      data[0] = (tempData & 0xFF000000)>>24;
      data[1] = (tempData & 0xFF0000)>>16;
      data[2] = (tempData & 0xFF00)>>8;
      data[3] = (tempData & 0xFF);
      for (int i = 2;i<4; ++i) {
         while(!USART_IsTransmitDataRegisterEmpty(USART_ModuleAddress_USART2)){};
         USART_SendData(USART_ModuleAddress_USART2, data[i]);
      }
      startBenchmark();
   }
} //lint !e1762 may change state of handler, must not be const
