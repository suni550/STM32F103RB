// (c) IMT - Information Management Technology AG, CH-9470 Buchs, www.imt.ch.
// SW guideline: Technote Coding Guidelines Version. 1.6
//
// Generated by DffGenerator (Version 1.00.0)
// Generated from LedHeartbeatAP.dff

// This file was initially generated but can be manually modified.

#include "LedHeartbeatAPHandler.h"
#include "..\..\..\..\..\..\STM32F103MD.Ping.Pong\ApplicationHardwareConfig.h"
#include "..\..\..\..\..\..\Imt.Base\Imt.Base.HAL.STM32F103MD\SystemPeripherals_TIM.h"
#include <Imt.Base.HAL.STM32F103MD/SystemPeripherals_RCC.h>
// Constructor.
LedHeartbeatAPHandler::LedHeartbeatAPHandler(LedHeartbeatAPIfc& sender) :
    m_heartBeatTimerTimer(sender.getHeartBeatTimerTimer()),
    m_sender(sender)
{
    // Nothing to do.
}

// Destructor.
LedHeartbeatAPHandler::~LedHeartbeatAPHandler(void) {
    // Nothing to do.
} //lint !e1762 may change state of handler, must not be const

// See ActivePartAbs.
void LedHeartbeatAPHandler::onInitialize(void) {
    // Nothing to do.
} //lint !e1762 may change state of handler, must not be const

// See ActivePartAbs.
void LedHeartbeatAPHandler::onStart(void) {
    // Nothing to do.
} //lint !e1762 may change state of handler, must not be const

// Generated periodic timer handler. @see LedHeartbeatAP::m_heartBeatTimerTimer for more information.
void LedHeartbeatAPHandler::handleHeartBeatTimerTimer(void) {
   bool ledStatues = R_STAT; //Read LED status and invert the status 
    // STAT LED is inverted

    if (ledStatues) {
        W_STAT = 0U;
    }
    else {
        W_STAT = 1U;
    }
    // TODO implement this Method
 
} //lint !e1762 may change state of handler, must not be const

// Generated ButtonPressEvent protocol handler.
void LedHeartbeatAPHandler::handleButtonPressEvent(const ButtonPressEventProtocol& message) {
    // TODO implement this Method
  
    if(m_sender.getHeartBeatTimerTimer().isRunning()){
        m_sender.getHeartBeatTimerTimer().stop();
        W_STAT = 0U;
    } 
    else
    {    
      m_sender.getHeartBeatTimerTimer().startTimer();
       W_STAT = 1U;
    }    
#if 0
   bool ledStatues = R_STAT; //Read LED status and invert the status 
    // STAT LED is inverted

    if (ledStatues) {
        W_STAT = 0U;
    }
    else {
        W_STAT = 1U;
    }
#endif    
} //lint !e1762 may change state of handler, must not be const

 